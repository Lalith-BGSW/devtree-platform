/*
 * USB consumers / regulators for CCS20 - generated by usb_dts_tool from the PinMux workbook.
 * Every NEEDS REVIEW comment is an open decision; nothing marked so is verified.
 * Format: default format (the vendor BSP style of the samples: tabs, mux{} / config{}, 'label: label').
 */

&usb0 {
	oc-gpio = <&tlmm 10 GPIO_ACTIVE_LOW>;
	/* Excel remark (GPIO_11): PD during reset */
	vbus-out-gpio = <&tlmm 11 GPIO_ACTIVE_HIGH>;
	pinctrl-names = "default";
	pinctrl-0 = <&usbv2_0_fault_detect &usbv2_0_power_enable>;

	qcom,default-mode-host;

	/* NEEDS REVIEW: debounce-delay-ms, the dwc3 child (unit address, usb-phy, maximum-speed) - only confirmed for the reference instance;
	 * add from a real reference if this instance needs them. */
};

&usb1 {
	oc-gpio = <&tlmm 12 GPIO_ACTIVE_LOW>;
	vbus-out-gpio = <&tlmm 13 GPIO_ACTIVE_HIGH>;
	pinctrl-names = "default";
	pinctrl-0 = <&usbv2_1_fault_detect &usbv2_1_power_enable>;

	/* NEEDS REVIEW: debounce-delay-ms, qcom,default-mode-host, the dwc3 child (unit address, usb-phy, maximum-speed) - only confirmed for the reference instance;
	 * add from a real reference if this instance needs them. */
};
